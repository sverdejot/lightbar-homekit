## CMakeLists.txt
```
cmake_minimum_required(VERSION 3.20.0)

find_package(Zephyr HINTS $ENV{ZEPHYR_BASE})

project(lightbar-homekit)

# Matter + Nordic Matter sample commons (task executor, Matter init helpers)
include(${ZEPHYR_CONNECTEDHOMEIP_MODULE_DIR}/config/nrfconnect/app/enable-gnu-std.cmake)
include(${ZEPHYR_CONNECTEDHOMEIP_MODULE_DIR}/src/app/chip_data_model.cmake)
include(${ZEPHYR_NRF_MODULE_DIR}/samples/matter/common/cmake/source_common.cmake)

target_include_directories(app PRIVATE
    src
    ${CONFIG_NCS_SAMPLE_MATTER_ZAP_FILES_PATH}
)

target_sources(app PRIVATE
    src/app_task.cpp
    src/main.cpp
    src/lamp_radio.c
)

# Data model: Matter Dimmable Light (OnOff + LevelControl) from the Nordic light bulb sample
chip_configure_data_model(app
    INCLUDE_SERVER
    BYPASS_IDL
    GEN_DIR ${CONFIG_NCS_SAMPLE_MATTER_ZAP_FILES_PATH}/zap-generated
    ZAP_FILE ${CMAKE_CURRENT_SOURCE_DIR}/${CONFIG_NCS_SAMPLE_MATTER_ZAP_FILES_PATH}/light_bulb.zap
)
```

## Kconfig
```
mainmenu "Xiaomi lightbar Matter bridge"

config LIGHTBAR_REMOTE_ID
	hex "Remote id of the Xiaomi light bar remote (24 bit)"
	range 0x0 0xffffff
	default 0x4c1d5a
	help
	  Id of the original 2.4 GHz remote, captured with tools/sniffer.
	  Alternatively keep the default and pair the bar to it with the
	  `lamp pair` shell command. Can also be changed at runtime with
	  `lamp id <hex>` (persisted in settings).

# Thread: full thread device (router capable), as in the Nordic light bulb sample
if NET_L2_OPENTHREAD

choice OPENTHREAD_NORDIC_LIBRARY_CONFIGURATION
	default OPENTHREAD_NORDIC_LIBRARY_FTD
endchoice

choice OPENTHREAD_DEVICE_TYPE
	default OPENTHREAD_FTD
endchoice

endif # NET_L2_OPENTHREAD

source "${ZEPHYR_CONNECTEDHOMEIP_MODULE_DIR}/config/nrfconnect/chip-module/Kconfig.features"
source "${ZEPHYR_CONNECTEDHOMEIP_MODULE_DIR}/config/nrfconnect/chip-module/Kconfig.defaults"
source "${ZEPHYR_NRF_MODULE_DIR}/samples/matter/common/src/Kconfig"
source "Kconfig.zephyr"
```

## Kconfig.sysbuild
```
# nice!nano v2: Adafruit UF2 bootloader, no MCUboot, no external flash, no factory data
choice BOOTLOADER
	default BOOTLOADER_NONE
endchoice

config MATTER_FACTORY_DATA_GENERATE
	default n

source "${ZEPHYR_BASE}/share/sysbuild/Kconfig"
```

## sysbuild.conf
```
SB_CONFIG_MATTER=y
SB_CONFIG_BOOTLOADER_NONE=y
SB_CONFIG_MATTER_FACTORY_DATA_GENERATE=n
SB_CONFIG_MATTER_OTA=n
```

## prj.conf
```kconfig
# Matter (Thread) dimmable light that drives the Xiaomi lightbar over its
# proprietary 2.4 GHz protocol (MPSL timeslots). Target: nice!nano v2.
CONFIG_CHIP=y
CONFIG_CHIP_PROJECT_CONFIG="src/chip_project_config.h"
CONFIG_CHIP_DEVICE_PRODUCT_ID=32773
CONFIG_STD_CPP17=y

# Commissioning: BLE advertising starts at boot. Test credentials (no factory data):
# passcode 20202021, discriminator 3840.
CONFIG_CHIP_ENABLE_PAIRING_AUTOSTART=y
CONFIG_CHIP_BLE_EXT_ADVERTISING=y
CONFIG_CHIP_BLE_ADVERTISING_DURATION=900
CONFIG_CHIP_FACTORY_DATA=n
CONFIG_CHIP_FACTORY_DATA_BUILD=n
CONFIG_BT_DEVICE_NAME="Lightbar"

# No DFU (no MCUboot / external flash on nice!nano)
CONFIG_CHIP_BOOTLOADER_NONE=y
CONFIG_CHIP_OTA_REQUESTOR=n
CONFIG_CHIP_OTA_IMAGE_BUILD=n
CONFIG_CHIP_DFU_OVER_BT_SMP=n

CONFIG_DK_LIBRARY=y
CONFIG_PWM=n
CONFIG_THREAD_NAME=y
CONFIG_MPU_STACK_GUARD=y
CONFIG_RESET_ON_FATAL_ERROR=n
CONFIG_USE_SEGGER_RTT=n

# Lamp radio: proprietary TX in MPSL timeslots
CONFIG_MPSL_TIMESLOT_SESSION_COUNT=1

# USB CDC console + shell (matter + lamp commands)
CONFIG_USB_DEVICE_STACK=y
CONFIG_USB_DEVICE_PRODUCT="Lightbar Matter"
CONFIG_USB_DEVICE_INITIALIZE_AT_BOOT=y
CONFIG_USB_CDC_ACM_LOG_LEVEL_OFF=y
CONFIG_UART_LINE_CTRL=y
CONFIG_SHELL=y
CONFIG_CHIP_LIB_SHELL=y
CONFIG_NCS_SAMPLE_MATTER_TEST_SHELL=n
CONFIG_REBOOT=y

CONFIG_BUILD_OUTPUT_UF2=y
```

## boards/adafruit_feather_nrf52840_nrf52840_uf2.overlay
```dts
/* nice!nano v2: Feather UF2 board definition, LED on P0.15, no QSPI flash */
/ {
	chosen {
		zephyr,entropy = &rng;
	};
};

&led0 {
	gpios = <&gpio0 15 GPIO_ACTIVE_HIGH>;
};

&qspi {
	status = "disabled";
};
```

## src/app_task.cpp
```c
// SPDX-License-Identifier: MIT
/*
 * Matter dimmable light -> Xiaomi Mi Computer Monitor Light Bar (MJGJD01YL).
 *
 * Apple Home / Siri control the OnOff and LevelControl clusters over Thread.
 * Changes are debounced and translated into the lamp's proprietary commands,
 * which lamp_radio.c sends in MPSL timeslots alongside Thread and BLE.
 */
#include "app_task.h"
#include "lamp_radio.h"

#include "app/matter_init.h"
#include "app/task_executor.h"

#include <app-common/zap-generated/attributes/Accessors.h>
#include <app-common/zap-generated/ids/Attributes.h>
#include <app-common/zap-generated/ids/Clusters.h>
#include <app/ConcreteAttributePath.h>
#include <app/clusters/identify-server/identify-server.h>
#include <app/server/Server.h>

#include <zephyr/drivers/gpio.h>
#include <zephyr/kernel.h>
#include <zephyr/logging/log.h>
#include <zephyr/settings/settings.h>
#include <zephyr/shell/shell.h>
#include <zephyr/sys/reboot.h>

#include <cstdlib>
#include <cstring>

LOG_MODULE_DECLARE(app, CONFIG_CHIP_APP_LOG_LEVEL);

using namespace ::chip;
using namespace ::chip::app;
using namespace ::chip::DeviceLayer;

namespace
{
constexpr EndpointId kLightEndpointId = 1;
constexpr int kApplyDelayMs = 300;

const struct gpio_dt_spec sLed = GPIO_DT_SPEC_GET(DT_ALIAS(led0), gpios);
volatile bool sThreadAttached;

/* Desired state (from Matter) and what we believe the lamp shows. */
volatile bool sWantOn;
volatile uint8_t sWantLevel = 254;
struct {
	bool on;
	int bri; /* 0..15, -1 unknown */
} sLamp = { false, -1 };

int LevelToBri(uint8_t level)
{
	if (level <= 1) {
		return 0;
	}
	return ((level - 1) * 15 + 126) / 253;
}

void SetAbsolute(uint8_t cmd, int value)
{
	/* Saturate to the lowest end, then step up (lamperez/xiaomi-lightbar-nrf24) */
	lamp_send(cmd, 0xF0);
	lamp_send(cmd, static_cast<uint8_t>(value));
}

void ApplyWorkHandler(k_work *)
{
	bool wantOn = sWantOn;
	int wantBri = LevelToBri(sWantLevel);

	if (wantOn != sLamp.on) {
		lamp_send(LAMP_CMD_TOGGLE, 0);
		sLamp.on = wantOn;
		LOG_INF("lamp -> %s", wantOn ? "ON" : "OFF");
	}
	if (sLamp.on && wantBri != sLamp.bri) {
		SetAbsolute(LAMP_CMD_BRIGHT, wantBri);
		sLamp.bri = wantBri;
		LOG_INF("lamp bri -> %d", wantBri);
	}
}

K_WORK_DELAYABLE_DEFINE(sApplyWork, ApplyWorkHandler);

void IdentifyStart(Identify *)
{
	/* Blink the lamp: two toggles */
	lamp_send(LAMP_CMD_TOGGLE, 0);
	lamp_send(LAMP_CMD_TOGGLE, 0);
}

void IdentifyStop(Identify *) {}

Identify sIdentify = { kLightEndpointId, IdentifyStart, IdentifyStop,
		       Clusters::Identify::IdentifyTypeEnum::kVisibleIndicator };

void MatterEventHandler(const ChipDeviceEvent *event, intptr_t)
{
	if (event->Type == DeviceEventType::kThreadStateChange ||
	    event->Type == DeviceEventType::kCommissioningComplete) {
		sThreadAttached = ConnectivityMgr().IsThreadAttached();
		LOG_INF("thread attached: %d", sThreadAttached);
	}
}

/* LED: slow blink until attached to the Thread network, then solid. */
void LedThread()
{
	gpio_pin_configure_dt(&sLed, GPIO_OUTPUT_INACTIVE);
	for (bool blink = false;; blink = !blink) {
		gpio_pin_set_dt(&sLed, sThreadAttached ? 1 : blink);
		k_sleep(K_MSEC(500));
	}
}

K_THREAD_DEFINE(led_thread_id, 512, LedThread, NULL, NULL, NULL, K_LOWEST_APPLICATION_THREAD_PRIO, 0, 0);

/* Remote id persisted in settings: lamp/id */
int LampSettingsSet(const char *name, size_t len, settings_read_cb readCb, void *cbArg)
{
	if (!strcmp(name, "id") && len == sizeof(uint32_t)) {
		uint32_t id;
		if (readCb(cbArg, &id, sizeof(id)) == sizeof(id)) {
			lamp_set_remote_id(id);
		}
	}
	return 0;
}

SETTINGS_STATIC_HANDLER_DEFINE(lamp, "lamp", NULL, LampSettingsSet, NULL, NULL);
} /* namespace */

void AppTask::OnOffChanged(bool on)
{
	sWantOn = on;
	k_work_reschedule(&sApplyWork, K_MSEC(kApplyDelayMs));
}

void AppTask::LevelChanged(uint8_t level)
{
	sWantLevel = level;
	k_work_reschedule(&sApplyWork, K_MSEC(kApplyDelayMs));
}

/* ---------------------------------------------------------- Matter hooks */

void MatterPostAttributeChangeCallback(const ConcreteAttributePath &path, uint8_t type, uint16_t size,
				       uint8_t *value)
{
	if (path.mClusterId == Clusters::OnOff::Id && path.mAttributeId == Clusters::OnOff::Attributes::OnOff::Id) {
		AppTask::Instance().OnOffChanged(*value);
	} else if (path.mClusterId == Clusters::LevelControl::Id &&
		   path.mAttributeId == Clusters::LevelControl::Attributes::CurrentLevel::Id) {
		AppTask::Instance().LevelChanged(*value);
	}
}

void emberAfOnOffClusterInitCallback(EndpointId endpoint)
{
	/* Assume the lamp matches the persisted state after a reboot; don't toggle it. */
	bool on = false;
	Clusters::OnOff::Attributes::OnOff::Get(endpoint, &on);
	sWantOn = on;
	sLamp.on = on;

	Clusters::LevelControl::Attributes::CurrentLevel::TypeInfo::Type level;
	if (Clusters::LevelControl::Attributes::CurrentLevel::Get(endpoint, level) ==
		    Protocols::InteractionModel::Status::Success &&
	    !level.IsNull()) {
		sWantLevel = level.Value();
	}
}

/* ------------------------------------------------------------------ app */

CHIP_ERROR AppTask::Init()
{
	ReturnErrorOnFailure(Nrf::Matter::PrepareServer());
	/* Matter only loads its own settings subtree; load ours explicitly. */
	settings_load_subtree("lamp");
	ReturnErrorOnFailure(Nrf::Matter::RegisterEventHandler(MatterEventHandler, 0));
	return Nrf::Matter::StartServer();
}

CHIP_ERROR AppTask::StartApp()
{
	ReturnErrorOnFailure(Init());

	while (true) {
		Nrf::DispatchNextTask();
	}

	return CHIP_NO_ERROR;
}

/* ---------------------------------------------------------------- shell */

static int CmdToggle(const struct shell *sh, size_t, char **)
{
	lamp_send(LAMP_CMD_TOGGLE, 0);
	sLamp.on = !sLamp.on;
	shell_print(sh, "toggle queued, lamp believed %s", sLamp.on ? "ON" : "OFF");
	return 0;
}

static int CmdBri(const struct shell *sh, size_t, char **argv)
{
	int v = CLAMP(atoi(argv[1]), 0, 15);
	SetAbsolute(LAMP_CMD_BRIGHT, v);
	sLamp.bri = v;
	return 0;
}

static int CmdId(const struct shell *sh, size_t argc, char **argv)
{
	if (argc > 1) {
		uint32_t id = strtoul(argv[1], NULL, 16) & 0xFFFFFF;
		lamp_set_remote_id(id);
		settings_save_one("lamp/id", &id, sizeof(id));
	}
	shell_print(sh, "remote id %06X", lamp_get_remote_id());
	return 0;
}

static int CmdState(const struct shell *sh, size_t argc, char **argv)
{
	if (argc > 1) {
		sLamp.on = !strcmp(argv[1], "on");
	}
	shell_print(sh, "lamp believed %s bri=%d | matter on=%d level=%d | thread=%d", sLamp.on ? "ON" : "OFF",
		    sLamp.bri, sWantOn, sWantLevel, sThreadAttached);
	return 0;
}

static int CmdBootloader(const struct shell *sh, size_t, char **)
{
	shell_print(sh, "rebooting into UF2 bootloader");
	k_sleep(K_MSEC(100));
	NRF_POWER->GPREGRET = 0x57; /* Adafruit bootloader: DFU_MAGIC_UF2_RESET */
	sys_reboot(SYS_REBOOT_COLD);
	return 0;
}

static int CmdPair(const struct shell *sh, size_t, char **)
{
	/* The bar accepts a new remote id when it gets a reset command within
	 * ~20 s of being powered on (same as long-pressing the original remote).
	 */
	for (int i = 0; i < 3; i++) {
		lamp_send(LAMP_CMD_RESET, 0);
	}
	shell_print(sh, "reset sent with id %06X; the bar should flash once", lamp_get_remote_id());
	return 0;
}

static int CmdDfu(const struct shell *sh, size_t, char **)
{
	shell_print(sh, "rebooting into serial DFU bootloader");
	k_sleep(K_MSEC(100));
	NRF_POWER->GPREGRET = 0x4E; /* Adafruit bootloader: DFU_MAGIC_SERIAL_ONLY_RESET */
	sys_reboot(SYS_REBOOT_COLD);
	return 0;
}

SHELL_STATIC_SUBCMD_SET_CREATE(lamp_cmds, SHELL_CMD_ARG(toggle, NULL, "Toggle lamp", CmdToggle, 1, 0),
			       SHELL_CMD_ARG(bri, NULL, "Brightness 0-15", CmdBri, 2, 0),
			       SHELL_CMD_ARG(id, NULL, "Remote id [hex]", CmdId, 1, 1),
			       SHELL_CMD_ARG(pair, NULL, "Pair bar to current id (power-cycle bar first)", CmdPair, 1, 0),
			       SHELL_CMD_ARG(state, NULL, "Show state / set belief [on|off]", CmdState, 1, 1),
			       SHELL_CMD_ARG(bootloader, NULL, "Reboot into UF2 bootloader", CmdBootloader, 1, 0),
			       SHELL_CMD_ARG(dfu, NULL, "Reboot into serial DFU (for big images)", CmdDfu, 1, 0),
			       SHELL_SUBCMD_SET_END);

SHELL_CMD_REGISTER(lamp, &lamp_cmds, "Xiaomi lightbar", NULL);
```

## src/app_task.h
```c
// SPDX-License-Identifier: MIT
#pragma once

#include <platform/CHIPDeviceLayer.h>

class AppTask {
public:
	static AppTask &Instance()
	{
		static AppTask sAppTask;
		return sAppTask;
	};

	CHIP_ERROR StartApp();

	/* Called from the Matter thread when cluster attributes change. */
	void OnOffChanged(bool on);
	void LevelChanged(uint8_t level);

private:
	CHIP_ERROR Init();
};
```

## src/lamp_radio.c
```c
// SPDX-License-Identifier: MIT
/*
 * Proprietary lamp TX through MPSL timeslots.
 *
 * Each command is sent as N short timeslots ("groups"). In every timeslot the
 * radio is configured as an nRF24L01+ compatible transmitter (Nordic 2 Mbit,
 * 5-byte address 0x5555555555, static 17-byte payload, no CRC, no PCF) and the
 * packet is sent REPS_PER_GROUP times on each of the 4 channels the bar listens
 * on. Between timeslots the 802.15.4 driver gets the radio back, so the Zigbee
 * link keeps working.
 */
#include <zephyr/kernel.h>
#include <zephyr/logging/log.h>
#include <zephyr/random/random.h>
#include <string.h>
#include <errno.h>

#include <mpsl_timeslot.h>
#include <hal/nrf_radio.h>

#include "lamp_radio.h"

LOG_MODULE_REGISTER(lamp_radio, LOG_LEVEL_INF);

#define PAYLOAD_LEN       17
#define REPS_PER_GROUP    2
#define GROUP_GAP_MS      8
#define DEFAULT_GROUPS    12
#define TIMESLOT_LEN_US   2500
#define TIMESLOT_WAIT_MS  60

static const uint8_t preamble[8] = {0x53, 0x39, 0x14, 0xDD, 0x1C, 0x49, 0x34, 0x12};
static const uint8_t channels[4] = {6, 15, 43, 68};

struct lamp_msg {
	uint8_t cmd;
	uint8_t opt;
};

K_MSGQ_DEFINE(lamp_msgq, sizeof(struct lamp_msg), 16, 1);

static uint32_t remote_id = CONFIG_LIGHTBAR_REMOTE_ID;
static uint8_t groups = DEFAULT_GROUPS;
static uint8_t counter;

/* Packet buffer read by the radio EasyDMA inside the timeslot. */
static uint8_t tx_packet[PAYLOAD_LEN];

enum ts_state { TS_IDLE, TS_PENDING, TS_DONE, TS_FAILED };
static volatile enum ts_state ts_state;
static mpsl_timeslot_session_id_t session_id = 0xFF;
static mpsl_timeslot_signal_return_param_t ts_ret;

static mpsl_timeslot_request_t ts_req = {
	.request_type = MPSL_TIMESLOT_REQ_TYPE_EARLIEST,
	.params.earliest = {
		.hfclk = MPSL_TIMESLOT_HFCLK_CFG_XTAL_GUARANTEED,
		.priority = MPSL_TIMESLOT_PRIORITY_NORMAL,
		.length_us = TIMESLOT_LEN_US,
		.timeout_us = 50000,
	},
};

static uint16_t crc16(const uint8_t *d, size_t n)
{
	uint16_t crc = 0xFFFE; /* poly 0x1021, init 0xFFFE, no reflection, no xorout */

	for (size_t i = 0; i < n; i++) {
		crc ^= (uint16_t)d[i] << 8;
		for (int b = 0; b < 8; b++) {
			crc = (crc & 0x8000) ? (crc << 1) ^ 0x1021 : crc << 1;
		}
	}
	return crc;
}

/* Runs inside the timeslot (MPSL TIMER0 IRQ context). ~150 us per packet. */
static void radio_tx_group(void)
{
	NRF_RADIO->INTENCLR = 0xFFFFFFFF;
	NRF_RADIO->POWER = 1;

	NRF_RADIO->MODE = RADIO_MODE_MODE_Nrf_2Mbit << RADIO_MODE_MODE_Pos;
	NRF_RADIO->MODECNF0 = (RADIO_MODECNF0_RU_Fast << RADIO_MODECNF0_RU_Pos) |
			      (RADIO_MODECNF0_DTX_Center << RADIO_MODECNF0_DTX_Pos);
	NRF_RADIO->PCNF0 = 0; /* no S0, LENGTH or S1 fields: raw static payload */
	NRF_RADIO->PCNF1 = (RADIO_PCNF1_WHITEEN_Disabled << RADIO_PCNF1_WHITEEN_Pos) |
			   (RADIO_PCNF1_ENDIAN_Big << RADIO_PCNF1_ENDIAN_Pos) |
			   (4 << RADIO_PCNF1_BALEN_Pos) |
			   (PAYLOAD_LEN << RADIO_PCNF1_STATLEN_Pos) |
			   (PAYLOAD_LEN << RADIO_PCNF1_MAXLEN_Pos);
	/* nRF24 address 0x5555555555, bit-reversed per byte as nrf_to_nrf does */
	NRF_RADIO->BASE0 = 0xAAAAAAAA;
	NRF_RADIO->PREFIX0 = 0xAA;
	NRF_RADIO->TXADDRESS = 0;
	NRF_RADIO->CRCCNF = 0;
	NRF_RADIO->TXPOWER = RADIO_TXPOWER_TXPOWER_Pos8dBm << RADIO_TXPOWER_TXPOWER_Pos;
	NRF_RADIO->PACKETPTR = (uint32_t)tx_packet;
	NRF_RADIO->SHORTS = RADIO_SHORTS_READY_START_Msk | RADIO_SHORTS_END_DISABLE_Msk;

	for (int rep = 0; rep < REPS_PER_GROUP; rep++) {
		for (int c = 0; c < ARRAY_SIZE(channels); c++) {
			NRF_RADIO->FREQUENCY = channels[c];
			NRF_RADIO->EVENTS_DISABLED = 0;
			NRF_RADIO->TASKS_TXEN = 1;
			while (NRF_RADIO->EVENTS_DISABLED == 0) {
			}
		}
	}
	NRF_RADIO->EVENTS_DISABLED = 0;
	NRF_RADIO->SHORTS = 0;
}

static mpsl_timeslot_signal_return_param_t *ts_callback(mpsl_timeslot_session_id_t sid,
							 uint32_t signal)
{
	ARG_UNUSED(sid);

	switch (signal) {
	case MPSL_TIMESLOT_SIGNAL_START:
		radio_tx_group();
		ts_state = TS_DONE;
		ts_ret.callback_action = MPSL_TIMESLOT_SIGNAL_ACTION_END;
		return &ts_ret;
	case MPSL_TIMESLOT_SIGNAL_BLOCKED:
	case MPSL_TIMESLOT_SIGNAL_CANCELLED:
		ts_state = TS_FAILED;
		return NULL;
	default:
		return NULL;
	}
}

static void build_packet(uint8_t cmd, uint8_t opt)
{
	memcpy(tx_packet, preamble, sizeof(preamble));
	tx_packet[8] = remote_id >> 16;
	tx_packet[9] = remote_id >> 8;
	tx_packet[10] = remote_id;
	tx_packet[11] = 0xFF;
	tx_packet[12] = counter++;
	tx_packet[13] = cmd;
	tx_packet[14] = opt;
	uint16_t c = crc16(tx_packet, 15);
	tx_packet[15] = c >> 8;
	tx_packet[16] = c & 0xFF;
}

/* Returns true if the group was transmitted. */
static bool send_group(void)
{
	ts_state = TS_PENDING;
	int32_t err = mpsl_timeslot_request(session_id, &ts_req);

	if (err) {
		LOG_ERR("timeslot request failed: %d", err);
		return false;
	}
	for (int i = 0; i < TIMESLOT_WAIT_MS && ts_state == TS_PENDING; i++) {
		k_sleep(K_MSEC(1));
	}
	return ts_state == TS_DONE;
}

/* MPSL APIs must be called from a cooperative (non-preemptible) thread. */
static void lamp_thread(void)
{
	struct lamp_msg msg;
	int32_t err = mpsl_timeslot_session_open(ts_callback, &session_id);

	if (err) {
		LOG_ERR("timeslot session open failed: %d", err);
		return;
	}
	counter = (uint8_t)sys_rand32_get();
	LOG_INF("lamp radio ready, remote id %06X", remote_id);

	while (k_msgq_get(&lamp_msgq, &msg, K_FOREVER) == 0) {
		int ok = 0;

		build_packet(msg.cmd, msg.opt);
		for (int g = 0; g < groups; g++) {
			ok += send_group();
			k_sleep(K_MSEC(GROUP_GAP_MS));
		}
		LOG_INF("sent cmd=%02X opt=%02X cnt=%u groups %d/%d", msg.cmd, msg.opt,
			tx_packet[12], ok, groups);
	}
}

K_THREAD_DEFINE(lamp_thread_id, 1024, lamp_thread, NULL, NULL, NULL,
		K_PRIO_COOP(CONFIG_MPSL_THREAD_COOP_PRIO), 0, 0);

int lamp_send(uint8_t cmd, uint8_t opt)
{
	struct lamp_msg msg = {.cmd = cmd, .opt = opt};

	return k_msgq_put(&lamp_msgq, &msg, K_NO_WAIT) ? -ENOMEM : 0;
}

void lamp_set_remote_id(uint32_t id)
{
	remote_id = id & 0xFFFFFF;
}

uint32_t lamp_get_remote_id(void)
{
	return remote_id;
}

void lamp_set_groups(uint8_t g)
{
	groups = CLAMP(g, 1, 100);
}

uint8_t lamp_get_groups(void)
{
	return groups;
}
```

## src/lamp_radio.h
```c
// SPDX-License-Identifier: MIT
/*
 * Xiaomi Mi Computer Monitor Light Bar (MJGJD01YL) proprietary 2.4 GHz TX,
 * sent from the nRF52840 radio inside MPSL timeslots so it coexists with
 * Thread and Bluetooth.
 *
 * Protocol: https://github.com/lamperez/xiaomi-lightbar-nrf24
 */
#ifndef LAMP_RADIO_H
#define LAMP_RADIO_H

#include <stdint.h>

#ifdef __cplusplus
extern "C" {
#endif

#define LAMP_CMD_TOGGLE 0x01
#define LAMP_CMD_COLOR  0x02 /* opt: signed step, + cooler / - warmer */
#define LAMP_CMD_BRIGHT 0x04 /* opt: signed step, + brighter / - dimmer */
#define LAMP_CMD_RESET  0x06

/* Queue one lamp command (non-blocking). Returns 0 or -ENOMEM if queue full. */
int lamp_send(uint8_t cmd, uint8_t opt);

void lamp_set_remote_id(uint32_t id);
uint32_t lamp_get_remote_id(void);

/* Number of timeslot groups per command (each group = all channels x 2 reps). */
void lamp_set_groups(uint8_t groups);
uint8_t lamp_get_groups(void);

#ifdef __cplusplus
}
#endif

#endif /* LAMP_RADIO_H */
```
